/* Copyright 2025 ETH Zurich and University of Bologna. */
/* Licensed under the Apache License, Version 2.0, see LICENSE for details. */
/* SPDX-License-Identifier: Apache-2.0 */

MEMORY
{
    L3 (rwxa) : ORIGIN = 0x70000000, LENGTH = 0x10000000
}
